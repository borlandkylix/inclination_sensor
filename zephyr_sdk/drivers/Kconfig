## zephyr_sdk/drivers/Kconfig
```kconfig
# Copyright (c) 2021 Nordic Semiconductor ASA
# SPDX-License-Identifier: Apache-2.0

menu "Drivers"
rsource "adc/Kconfig"
rsource "blink/Kconfig"
rsource "sensor/Kconfig"
rsource "mfd/Kconfig"
rsource "serial/Kconfig"
endmenu
```
